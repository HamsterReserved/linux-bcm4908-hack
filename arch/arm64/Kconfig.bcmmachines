## arch/arm64/Kconfig.bcmmachines
```kconfig
choice
	prompt "Broadcom Commengine board type"
	default BCM94908
	help
	  Select different Broadcom ADSL board

config BCM94908
	bool "4908 Wireless Router board"
	depends on ARM64

endchoice
```

## bcmdrivers/Kconfig
```kconfig
menu "Broadcom drivers"

source "bcmdrivers/drivers/stubs/Kconfig"

source "bcmdrivers/drivers/plat-bcm/Kconfig"

source "bcmdrivers/drivers/bus/pci/host/Kconfig"

source "bcmdrivers/drivers/net/enet/impl5/Kconfig"

source "bcmdrivers/drivers/net/lib/pktdma/Kconfig"

source "bcmdrivers/shared/boardparms/bcm963xx/Kconfig"

source "bcmdrivers/shared/pmc/Kconfig"

endmenu
```

## bcmdrivers/drivers/bus/pci/host/Kconfig
```kconfig
config BCM_PCI
	bool "Support for PCI"
	select PCI
	select PCI_DOMAINS
	select PCI_QUIRKS

# NOTE: the select PCI_DOMAINS line will cause problems with old kernel, but removing it
#	will cause PCI_DOMAINS to be removed from the .config file for some unknown reason...

config BCM_PCIE_HCD
	bool "PCIe host controller driver from bcmdriver"
	depends on BCM_PCI
	default  y

config BCM_PCIE_SSC
	bool "Enable PCIe Spread Spectrum Clocking"
	default  n
	depends on BCM_PCI
```

## bcmdrivers/drivers/char/board/bcm963xx/Kconfig
```kconfig
config BCM_BOARD_API
	bool "Broadcom board APIs"
	help
		Common APIs to get chip IDs etc.
```

## bcmdrivers/drivers/net/enet/impl5/Kconfig
```kconfig
config BCM_ENET_NO_RDP
	bool "Ethernet driver without RDP"
	depends on BCM_PKTDMA
	help
		 RDP refers to Runner Data Path. This option provides access to
		 network by GMAC.
```

## bcmdrivers/drivers/plat-bcm/Kconfig
```kconfig
config BCM_MAP_LEGACY
	bool "Legacy IO / IRQ mapper"
	help
		Support legacy drivers without DT support.
```

## bcmdrivers/drivers/stubs/Kconfig
```kconfig
config BCM_FUNC_STUBS
	bool "Stubs for Broadcom board APIs and utilities"
	help
		Stubs of most common APIs to get chip IDs etc,
		so the huge board API module can be dropped.
```

## bcmdrivers/shared/boardparms/bcm963xx/Kconfig
```kconfig
config BCM_BOARDPARMS_R8000P
	bool "Board parameters for R8000P"
	help
		Describes detailed pinouts of the board. Applicable for R8000P only.
```

## bcmdrivers/shared/pmc/Kconfig
```kconfig
config BCM_PMC
	bool "PMC"
	depends on BCM96838 || BCM963138 || BCM963148 || BCM963381 || BCM96848 || BCM94908 || BCM96858
	help
		Power management controller
```
